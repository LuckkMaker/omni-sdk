## omni/Kconfig
```kconfig
mainmenu "OMNI Configuration"

rsource "components/Kconfig"
rsource "drivers/Kconfig"
rsource "libraries/Kconfig"
```

## omni/components/Kconfig
```kconfig
menu "Components"

rsource "console/Kconfig"
rsource "cherryusb/Kconfig"

endmenu # Components
```

## omni/components/cherryusb/Kconfig
```kconfig
menuconfig COMPONENT_CHERRYUSB
    bool "CherryUSB"
    default n
    select USB
    help
        Enable the CherryUSB component configuration.

if COMPONENT_CHERRYUSB

endif # COMPONENT_CHERRYUSB
```

## omni/components/console/Kconfig
```kconfig
menuconfig COMPONENT_CONSOLE
    bool "Console"
    default n
    help
        Enable the console component configuration.

if COMPONENT_CONSOLE

endif # COMPONENT_CONSOLE
```

## omni/drivers/Kconfig
```kconfig
menuconfig OMNI_DRIVER
    bool "Drivers"
    default n
    help
        Enable the drivers configuration.

if OMNI_DRIVER
    config OMNI_ASSERT
        bool "Assert Enable"
        default n
        help
            Enable the assert driver.

rsource "display/Kconfig"
rsource "i2c/Kconfig"
rsource "usart/Kconfig"
rsource "usb/Kconfig"
rsource "timer/Kconfig"

endif # OMNI_DRIVER
```

## omni/drivers/display/Kconfig
```kconfig
menuconfig OMNI_DRIVER_DISPLAY
    bool "Display"
    default n
    help
        Enable the display controller drivers configuration.

if OMNI_DRIVER_DISPLAY

rsource "Kconfig.ssd1306"

endif # OMNI_DRIVER_DISPLAY
```

## omni/drivers/display/Kconfig.ssd1306
```kconfig
menuconfig SSD1306
    bool "SSD1306"
    default n
    help
        Enable the display controller driver for the SSD1306 display controller.

if SSD1306

endif # SSD1306
```

## omni/drivers/i2c/Kconfig
```kconfig
menuconfig OMNI_DRIVER_I2C
    bool "I2C"
    default n
    help
        Enable the I2C driver configuration.

if OMNI_DRIVER_I2C

endif # OMNI_DRIVER_I2C
```

## omni/drivers/ipc/Kconfig
```kconfig
menuconfig OMNI_DRIVER_IPC
    bool "IPC"
    default n
    help
        Enable the IPC driver configuration.

if OMNI_DRIVER_IPC

endif # OMNI_DRIVER_IPC
```

## omni/drivers/spi/Kconfig
```kconfig
menuconfig OMNI_DRIVER_SPI
    bool "SPI"
    default n
    help
        Enable the SPI driver configuration.

if OMNI_DRIVER_SPI

endif # OMNI_DRIVER_SPI
```

## omni/drivers/timer/Kconfig
```kconfig
menuconfig OMNI_DRIVER_TIMER
    bool "Timer"
    default n
    help
        Enable the Timer driver configuration.

if OMNI_DRIVER_TIMER

endif # OMNI_DRIVER_TIMER
```

## omni/drivers/usart/Kconfig
```kconfig
menuconfig OMNI_DRIVER_USART
    bool "USART"
    default n
    help
        Enable the USART driver configuration.

if OMNI_DRIVER_USART

endif # OMNI_DRIVER_USART
```

## omni/drivers/usb/Kconfig
```kconfig
menuconfig OMNI_DRIVER_USB
    bool "USB"
    default n
    help
        Enable the USB Phy driver configuration.

if OMNI_DRIVER_USB

endif # OMNI_DRIVER_USB
```

## omni/libraries/Kconfig
```kconfig
menu "Libraries"

config U8G2
    bool "U8g2"
    default n

config SEGGER_RTT
    bool "Segger RTT"
    default n

config SHELL_LETTER
    bool "Letter Shell"
    default n

menu "RTOS"

config RTOS_CMSIS_RTX
    bool "CMSIS RTX"
    default n

config RTOS_CMSIS_FREERTOS
    bool "CMSIS FreeRTOS"
    default n

config RTOS_THREADX
    bool "ThreadX"
    default n

if RTOS_THREADX
    rsource "threadx/Kconfig"
endif # RTOS_THREADX

endmenu # RTOS

menu "USB"

config USB_CHERRYUSB
    bool "Cherry USB"
    default n

if USB_CHERRYUSB
    rsource "cherryusb/Kconfig"
endif # USB_CHERRYUSB

config USB_STM32
    bool "STM32 USB"
    default n

config USB_USBX
    bool "USBX"
    default n

if USB_USBX
    rsource "usbx/Kconfig"
endif # USB_USBX

endmenu # USB

config USE_RTOS
    bool
    default n if RTOS_NONE
    default y if RTOS_CMSIS_FREERTOS
    default y if RTOS_CMSIS_RTX
    default y if RTOS_THREADX

endmenu # Libraries
```

## omni/targets/Kconfig
```kconfig
menu "Targets"

    config CUSTOM_LINKER_SCRIPT
        bool "Use custom linker script"
        help
            Select this option to use a custom linker script.

    # config CUSTOM_DRIVER_INIT
    #     bool "Use custom driver init"
    #     help
    #         Select this option to use a custom driver init.

endmenu # Targets
```
